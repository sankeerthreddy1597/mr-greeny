## firmware/main/Kconfig.projbuild
```kconfig
menu "Mr. Greeny Configuration"

    config MRGREENY_BACKEND_WS_URL
        string "Backend WebSocket URL"
        default "ws://192.168.1.100:8000/ws/stream"
        help
            WebSocket endpoint of the mr-greeny backend (see ../backend). Point this
            at the LAN IP of the machine running the backend, e.g.
            ws://<your-machine-ip>:8000/ws/stream.

endmenu
```

## firmware/sdkconfig.defaults
```kconfig
# Board-required defaults for Waveshare ESP32-S3-Touch-AMOLED-1.75
# (octal PSRAM mode, 16MB flash) -- carried over from the waveshare-examples
# 02_lvgl_demo_v9 reference project.
CONFIG_ESPTOOLPY_FLASHMODE_QIO=y
CONFIG_ESPTOOLPY_FLASHSIZE_16MB=y
CONFIG_PARTITION_TABLE_CUSTOM=y
CONFIG_COMPILER_OPTIMIZATION_PERF=y
CONFIG_SPIRAM=y
CONFIG_SPIRAM_MODE_OCT=y
CONFIG_SPIRAM_FETCH_INSTRUCTIONS=y
CONFIG_SPIRAM_RODATA=y
CONFIG_SPIRAM_SPEED_80M=y
CONFIG_SPIRAM_XIP_FROM_PSRAM=y
CONFIG_ESP32S3_INSTRUCTION_CACHE_32KB=y
CONFIG_ESP32S3_DATA_CACHE_64KB=y
CONFIG_ESP_DEFAULT_CPU_FREQ_MHZ_240=y
CONFIG_ESP32S3_DATA_CACHE_LINE_64B=y

CONFIG_FREERTOS_HZ=1000
CONFIG_LV_USE_CLIB_MALLOC=y
CONFIG_LV_USE_CLIB_STRING=y
CONFIG_LV_USE_CLIB_SPRINTF=y
CONFIG_LV_DEF_REFR_PERIOD=15
CONFIG_LV_OS_FREERTOS=y
CONFIG_LV_OBJ_STYLE_CACHE=y

CONFIG_LV_DRAW_SW_DRAW_UNIT_CNT=2
CONFIG_LV_ATTRIBUTE_FAST_MEM_USE_IRAM=y
CONFIG_LV_FONT_MONTSERRAT_12=y
CONFIG_LV_FONT_MONTSERRAT_16=y
CONFIG_LV_FONT_MONTSERRAT_18=y
CONFIG_LV_FONT_MONTSERRAT_20=y
CONFIG_LV_FONT_MONTSERRAT_22=y
CONFIG_LV_FONT_MONTSERRAT_24=y
CONFIG_LV_FONT_MONTSERRAT_26=y
CONFIG_LV_USE_FONT_COMPRESSED=y
CONFIG_LV_TXT_BREAK_CHARS=" ,.;:-_"
# LV_USE_PERF_MONITOR draws a live FPS/CPU overlay (default bottom-right) --
# fine for benchmarking the original demo this scaffold came from, but shows
# up as unexplained moving pixels in the real UI. Left disabled here.
# CONFIG_LV_USE_SYSMON is not set
# CONFIG_LV_USE_PERF_MONITOR is not set
CONFIG_LV_USE_IMGFONT=y
CONFIG_IDF_EXPERIMENTAL_FEATURES=y
```
